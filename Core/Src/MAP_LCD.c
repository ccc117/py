/*
 * MAP_LCD.c
 *
 *  Created on: Jan 12, 2024
 *      Author: MAP Lab
 */


#include "MAP_LCD.h"
#include <math.h>
#include <stdarg.h>

static uint16_t print_color	= COLOR_BLACK;
static uint16_t print_size	= 1; //size = 0 ~ 3
static const uint16_t print_margin = 2;
static uint16_t print_position_x = print_margin;
static uint16_t print_position_y = print_margin;

void LCD_BL_on()
{
	HAL_GPIO_WritePin(LCD_BL_GPIO_Port, LCD_BL_Pin, GPIO_PIN_SET);
}

void LCD_BL_off()
{
	HAL_GPIO_WritePin(LCD_BL_GPIO_Port, LCD_BL_Pin, GPIO_PIN_RESET);
}


void LCD_Check_ID()
{
	uint16_t temp;
	BANK1_index = 0xd3;
	temp = BANK1_A10_data; //dummy
	temp = BANK1_A10_data; //0x00
	temp = BANK1_A10_data; //0x93
	temp <<= 8;
	temp |= BANK1_A10_data; //0x41
	temp = 0;
}

void LCD_init()
{
//SOFTWARE RESET
BANK1_index = 0x01;
HAL_Delay(100);

//POWER CONTROL A
BANK1_index = 0xCB;
BANK1_A10_data = 0x39;
BANK1_A10_data = 0x2C;
BANK1_A10_data = 0x00;
BANK1_A10_data = 0x34;
BANK1_A10_data = 0x02;

//POWER CONTROL B
BANK1_index = 0xCF;
BANK1_A10_data = 0x00;
BANK1_A10_data = 0xC1;
BANK1_A10_data = 0X30;

//DRIVER TIMING CONTROL A
BANK1_index = 0xE8;
BANK1_A10_data = 0x85;
BANK1_A10_data = 0x10;
BANK1_A10_data = 0x7A;  //78

//DRIVER TIMING CONTROL B
BANK1_index = 0xEA;
BANK1_A10_data = 0x00;
BANK1_A10_data = 0x00;

//POWER ON SEQUENCE CONTROL
BANK1_index = 0xED;
BANK1_A10_data = 0x64;
BANK1_A10_data = 0x03;
BANK1_A10_data = 0X12;
BANK1_A10_data = 0X81;

//PUMP RATIO CONTROL
BANK1_index = 0xF7;
BANK1_A10_data = 0x20;

//POWER CONTROL,VRH[5:0]
BANK1_index = 0xC0;    //Power control
BANK1_A10_data = 0x1B;   //VRH[5:0]

//POWER CONTROL,SAP[2:0];BT[3:0]
BANK1_index = 0xC1;    //Power control
BANK1_A10_data = 0x01;   //SAP[2:0];BT[3:0]

//VCM CONTROL
BANK1_index = 0xC5;    //VCM control
BANK1_A10_data = 0x30; 	 //3F  3E
BANK1_A10_data = 0x30; 	 //3C	28

//VCM CONTROL 2
BANK1_index = 0xC7;
BANK1_A10_data = 0XB7;

//MEMORY ACCESS CONTROL
BANK1_index = 0x36;
BANK1_A10_data = 0x48;

//PIXEL FORMAT
BANK1_index = 0x3A;
BANK1_A10_data = 0x55;

//FRAME RATIO CONTROL, STANDARD RGB COLOR
BANK1_index = 0xB1;
BANK1_A10_data = 0x00;
BANK1_A10_data = 0x1A;

//DISPLAY FUNCTION CONTROL(<-->)
BANK1_index = 0xB6;
BANK1_A10_data = 0x08;
BANK1_A10_data = 0x82;
BANK1_A10_data = 0x27;

//3GAMMA FUNCTION DISABLE
BANK1_index = 0xF2;
BANK1_A10_data = 0x00;

//GAMMA CURVE SELECTED
BANK1_index = 0x26;
BANK1_A10_data = 0x01;

//POSITIVE GAMMA CORRECTION
BANK1_index = 0xE0;    //Set Gamma
BANK1_A10_data = 0x0F;
BANK1_A10_data = 0x2A;
BANK1_A10_data = 0x28;
BANK1_A10_data = 0x08;
BANK1_A10_data = 0x0E;
BANK1_A10_data = 0x08;
BANK1_A10_data = 0x54;
BANK1_A10_data = 0XA9;
BANK1_A10_data = 0x43;
BANK1_A10_data = 0x0A;
BANK1_A10_data = 0x0F;
BANK1_A10_data = 0x00;
BANK1_A10_data = 0x00;
BANK1_A10_data = 0x00;
BANK1_A10_data = 0x00;

//NEGATIVE GAMMA CORRECTION
BANK1_index = 0XE1;    //Set Gamma
BANK1_A10_data = 0x00;
BANK1_A10_data = 0x15;
BANK1_A10_data = 0x17;
BANK1_A10_data = 0x07;
BANK1_A10_data = 0x11;
BANK1_A10_data = 0x06;
BANK1_A10_data = 0x2B;
BANK1_A10_data = 0x56;
BANK1_A10_data = 0x3C;
BANK1_A10_data = 0x05;
BANK1_A10_data = 0x10;
BANK1_A10_data = 0x0F;
BANK1_A10_data = 0x3F;
BANK1_A10_data = 0x3F;
BANK1_A10_data = 0x0F;

//PAGE ADDRESS SET
BANK1_index = 0x2B;
BANK1_A10_data = 0x00;
BANK1_A10_data = 0x00;
BANK1_A10_data = 0x01;
BANK1_A10_data = 0x3f;

//COLUMN ADDRESS SET
BANK1_index = 0x2A;
BANK1_A10_data = 0x00;
BANK1_A10_data = 0x00;
BANK1_A10_data = 0x00;
BANK1_A10_data = 0xef;
//EXIT SLEEP
BANK1_index = 0x11;

HAL_Delay(120);

//TURN ON DISPLAY
BANK1_index = 0x29;

} //End of LCD Initialization

void LCD_SetPos(uint16_t xPos, uint16_t yPos)
{
	BANK1_index = LCD_xpos_cmd;
	BANK1_A10_data = xPos>>8;
	BANK1_A10_data = xPos&0xff;
	BANK1_index = LCD_ypos_cmd;
	BANK1_A10_data = yPos>>8;
	BANK1_A10_data = yPos&0xff;
}


void LCD_Clear(uint16_t Color)
{
	int i;
	LCD_SetPos(0,0);
	//LCD_buf[10][11] = Color;
	BANK1_index = LCD_wram_cmd;
	for(i = 0; i < LCD_width * LCD_height ; i++)
	{
		BANK1_A10_data = Color;
	}

	print_position_x = print_margin;
	print_position_y = print_margin;
}


void LCD_Draw_Point(uint16_t x, uint16_t y, uint16_t Color)
{

	if( x < 0 )
	{
		x = 0;
	}
	else
	{
		x = x % LCD_width;
	}

	if( y < 0 )
	{
		y = 0;
	}
	else
	{
		y = y % LCD_height;
	}

	LCD_SetPos(x,y);
	BANK1_index = LCD_wram_cmd;
	BANK1_A10_data = Color;
}

/* ── 내장 5x7 ASCII 폰트 (32~127) ── */
static const uint8_t LCD_Font5x7[][5] = {
    {0x00,0x00,0x00,0x00,0x00}, // 32 (space)
    {0x00,0x00,0x5F,0x00,0x00}, // 33 !
    {0x00,0x07,0x00,0x07,0x00}, // 34 "
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    {0x08,0x1C,0x2A,0x08,0x08}, //127 DEL
};

void LCD_DrawChar(uint16_t x, uint16_t y, char ch, uint16_t color, uint16_t bg, uint8_t size)
{
    if (ch < 32 || ch > 127) ch = '?';
    uint8_t idx = (uint8_t)(ch - 32);
    for (uint8_t i = 0; i < 6; i++) {
        uint8_t line = (i < 5) ? LCD_Font5x7[idx][i] : 0x00;
        for (uint8_t j = 0; j < 8; j++) {
            uint16_t c = (line & (1 << j)) ? color : bg;
            if (size <= 1) {
                LCD_Draw_Point(x + i, y + j, c);
            } else {
                for (uint8_t sx = 0; sx < size; sx++)
                    for (uint8_t sy = 0; sy < size; sy++)
                        LCD_Draw_Point(x + i * size + sx, y + j * size + sy, c);
            }
        }
    }
}

void LCD_DrawString(uint16_t x, uint16_t y, const char *str, uint16_t color, uint16_t bg, uint8_t size)
{
    uint8_t w = (size <= 1) ? 6 : 6 * size;
    while (*str) {
        if (x + w > 240) { x = 0; y += (size <= 1) ? 8 : 8 * size; }
        LCD_DrawChar(x, y, *str, color, bg, size);
        x += w;
        str++;
    }
}



